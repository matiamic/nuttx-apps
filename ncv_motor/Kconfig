## ncv_motor/dbw_steer/Kconfig
```kconfig
config DBW_STEER
	tristate "Drive-by-wire steering wheel"
	default n
	depends on PWM && DEV_GPIO
	---help---
		Enable the drive-by-wire demo steering wheel
```

## ncv_motor/dbw_wheel/Kconfig
```kconfig
config DBW_WHEEL
	tristate "Drive-by-wire wheel"
	default n
	depends on PWM && DEV_GPIO
	---help---
		Enable the drive-by-wire demo wheel
```

## ncv_motor/remote/Kconfig
```kconfig
config MOTOR_REMOTE
	tristate "Remote controller for motor_pwm program"
	default n
```

## oa_tc6_testing/mdio_test/Kconfig
```kconfig
config MDIO_TEST
	tristate "MDIO test tool"
	default n
	---help---
		Enable the MDIO test tool
```

## oa_tc6_testing/plcatool/Kconfig
```kconfig
config PLCATOOL
	tristate "plcatool"
	default n
	---help---
		Enable the plcatool
```
